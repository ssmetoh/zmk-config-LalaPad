## config/west.yml
```yaml
manifest:
  remotes:
    - name: zmkfirmware
      url-base: https://github.com/zmkfirmware
    - name: ShiniNet
      url-base: https://github.com/ShiniNet/
    - name: caksoylar 
      url-base: https://github.com/caksoylar  
  projects:
    - name: zmk
      remote: zmkfirmware
      revision: a7272d2
      import: app/west.yml
    - name: cirque-input-module
      remote: ShiniNet
      revision: a7272d2
    - name: zmk-rgbled-widget
      remote: caksoylar
      revision: main
  self:
    path: config
```
